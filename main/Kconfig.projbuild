## main/Kconfig.projbuild
```kconfig
menu "Farpatch Configuration"

    choice HARDWARE_MODEL
        prompt "Hardware Model"
        default FARPATCH_DVT4 if IDF_TARGET_ESP32S3
        default ESP32_WROVER_B
        help
            Which hardware to build for.

        config FARPATCH_DVT2
            depends on IDF_TARGET_ESP32
            bool "Farpatch DVT2"
        config FARPATCH_DVT3
            depends on IDF_TARGET_ESP32S3
            bool "Farpatch DVT3"
        config FARPATCH_DVT3_NOPSU
            depends on IDF_TARGET_ESP32S3
            bool "Farpatch DVT3 (no power supply)"
        config FARPATCH_DVT4
            depends on IDF_TARGET_ESP32S3
            bool "Farpatch DVT4"
        config FARPATCH_DVT5
            depends on IDF_TARGET_ESP32S3
            bool "Farpatch DVT5"
        config FARPATCH_DVT6
            depends on IDF_TARGET_ESP32C6
            bool "Farpatch DVT6"
        config FARPATCH_DVT7
            depends on IDF_TARGET_ESP32C6
            bool "Farpatch DVT7"
        config ESP32C3_MINI1
            depends on IDF_TARGET_ESP32C3
            bool "ESP32C3-MINI1"
        config M5_STAMP
            depends on IDF_TARGET_ESP32C3
            bool "M5 Stamp"
        config GIBRALTAR
            depends on IDF_TARGET_ESP32C3
            bool "Gibraltar"
        config ESP32_WROVER_B
            depends on IDF_TARGET_ESP32
            bool "ESP32-WROVER-B"
        config CUSTOM_HARDWARE
            bool "Custom PCB"
    endchoice # HARDWARE_MODEL

    config TDI_GPIO
        int "TDI GPIO"
        depends on CUSTOM_HARDWARE
        help
        TDI GPIO number

    config TDO_GPIO
        int "TDO GPIO"
        depends on CUSTOM_HARDWARE
        default 14
        help
        TDO GPIO number

    config TMS_SWDIO_GPIO
        int "SWDIO/TMS GPIO"
        depends on CUSTOM_HARDWARE
        default 0
        help
        TMS/SWDIO GPIO number

    config TMS_SWDIO_DIR_GPIO
        int "SWDIO/TMS direction GPIO"
        depends on CUSTOM_HARDWARE
        default 1
        help
        TMS/SWDIO direction GPIO number, or -1 if not present

    config TCK_SWCLK_GPIO
        int "SWCLK/TCK GPIO"
        depends on CUSTOM_HARDWARE
        default 2
        help
        TCK/SWDIO GPIO number		

    config TCK_TDI_DIR_GPIO
        int "TCK/SWDIO/TDI direction GPIO"
        depends on CUSTOM_HARDWARE
        default -1
        help
        TCK/SWDIO/TDI direction GPIO number, or -1 if not present

    config NRST_GPIO
        int "NRST GPIO"
        depends on CUSTOM_HARDWARE
        default 12
        help
        Reset GPIO Number

    config LED_GPIO
        int "LED GPIO"
        depends on CUSTOM_HARDWARE
        default 13
        help
        LED GPIO Number

    config LED2_GPIO
        int "LED2 GPIO"
        depends on CUSTOM_HARDWARE
        default -1
        help
        Second LED GPIO Number, or -1 if not present

    config UART_TX_GPIO
        int "UART TX pin"
        depends on CUSTOM_HARDWARE
        default 26
        help
        Pin to use for UART TX

    config UART_RX_GPIO
        int "UART RX pin"
        depends on CUSTOM_HARDWARE
        default 27
        help
        Pin to use for UART RX

    config ESP_DEBUG_LOGS
        bool "Enable ESP debug logs"
        default y
        help
        Make ESP debug logs available via websockets

    config GDB_TCP_PORT
        int "TCP port number"
        default 2022
        help
        TCP port number that the GDB server will run on

    config MAX_STA_CONN
        int "Maximum number of wifi clients in AP mode"
        default 4
        help
        Max number of wifi clients that can connect to AP mode.

    config MAX_SSID_SCAN_RESULTS
        int "Maximum number of results in an SSID scan"
        default 40
        help
        Maximum number of entries in the list of available SSIDs.

    config DEFAULT_AP_SSID_PREFIX
        string "Access Point SSID Prefix"
        default "Farpatch"
        help
        SSID (network name) that the device will broadcast.

    config DEFAULT_AP_PASSWORD
        string "Access Point Password"
        default ""
        help
        Password used for the Access Point. Leave empty and set AUTH MODE to WIFI_AUTH_OPEN for no password.

    config DEFAULT_AP_CHANNEL
        int "Access Point WiFi Channel"
        default 1
        help
        Be careful you might not see the access point if you use a channel not allowed in your country.

    config DEFAULT_AP_IP
        string "Access Point IP Address"
        default "10.10.0.1"
        help
        This is used for the redirection to the captive portal. It is recommended to leave unchanged.

    config DEFAULT_AP_GATEWAY
        string "Access Point IP Gateway"
        default "10.10.0.1"
        help
        This is used for the redirection to the captive portal. It is recommended to leave unchanged.

    config DEFAULT_AP_NETMASK
        string "Access Point Netmask"
        default "255.0.0.0"
        help
        This is used for the redirection to the captive portal. It is recommended to leave unchanged.

    config DEFAULT_AP_MAX_CONNECTIONS
        int "Access Point Max Connections"
        default 4
        help
        Max is 4.

    config DEFAULT_AP_BEACON_INTERVAL
        int "Access Point Beacon Interval (ms)"
        default 100
        help
        100ms is the recommended default.

    config RTT_TCP_PORT
        int "TCP port number for RTT access"
        default 2123
        help
        RTT will listen on this port for TCP connections. Use -1 to disable.

    config RTT_UDP_PORT
        int "UDP port number for RTT access"
        default 2124
        help
        RTT will listen on this port for UDP connections. Use -1 to disable.

    config UART_TCP_PORT
        int "TCP port number for UART access"
        default 23
        help
        UART will listen on this port for TCP connections. Use -1 to disable.

    config UART_UDP_PORT
        int "UDP port number for UART access"
        default 2323
        help
        UART will listen on this port for UDP connections. Use -1 to disable.

    config SWO_TCP_PORT
        int "TCP port number for SWO access"
        default 3443
        help
        Raw SWO data will be made available on this port. Use -1 to disable.

    config PRODUCT_NAME
        string "Product Name"
        default "farpatch"
        help
        Name of the product, used in hostnames and mDNS.

    config RTT_ON_BOOT
        bool "Start RTT server on boot"
        default n
        help
        Start RTT on boot without waiting for a GDB client to connect.

    config RESET_TARGET_ON_BOOT
        bool "Reset target on boot"
        default n
        help
        Reset the target when the debugger starts up.

    config RTT_MAX_CONNECTIONS
        int "Maximum number of simultaneous RTT connections"
        default 1
        help
        The maximum number of RTT clients that can be connected at one time.

    config RTT_MAX_CHANNELS
        int "Largest supported RTT channel"
        default 1
        help
        A variable number of TCP ports will be opened to support this many channels.

    config CATCH_CORE_RESET
        bool "Catch target reset events"
        default y
        help
        Break into the debugger when the target resets.

    config CATCH_CORE_HARDFAULT
        bool "Catch target hardfault events"
        default y
        help
        Break into the debugger when the target experiences a hardfault.

endmenu
```
